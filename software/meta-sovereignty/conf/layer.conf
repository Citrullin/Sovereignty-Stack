## software/meta-sovereignty/conf/layer.conf
```bitbake
# We have a conf and classes directory, add to BBPATH
BBPATH .= ":${LAYERDIR}"

# We have recipes-* directories, add to BBFILES
BBFILES += "${LAYERDIR}/recipes-*/*/*.bb \
            ${LAYERDIR}/recipes-*/*/*.bbappend"

BBFILE_COLLECTIONS += "meta-sovereignty"
BBFILE_PATTERN_meta-sovereignty = "^${LAYERDIR}/"
BBFILE_PRIORITY_meta-sovereignty = "10"

LAYERDEPENDS_meta-sovereignty = "core"
LAYERSERIES_COMPAT_meta-sovereignty = "scarthgap"
```
